## firmware/sdkconfig.defaults
```kconfig
# Wi-Fi
CONFIG_ESP_WIFI_MODE_STA=y

# FreeRTOS — enable pinning tasks to cores
CONFIG_FREERTOS_UNICORE=n

# Larger main task stack for JSON parsing
CONFIG_ESP_MAIN_TASK_STACK_SIZE=4096

# lwIP — increase UDP receive buffer
CONFIG_LWIP_UDP_RECVMBOX_SIZE=32

# Partition table — default single factory
CONFIG_PARTITION_TABLE_SINGLE_APP=y
```
